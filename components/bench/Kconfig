## components/gnss_link/Kconfig
```kconfig
# SPDX-FileCopyrightText: 2026 Avery L.
# SPDX-License-Identifier: MIT
menu "Station: GNSS link"

    config GNSS_LINK_DEFAULT_BAUD
        int "Default receiver COM1 baud rate"
        range 9600 921600
        default 115200
        help
            Baud rate the link opens at when no rate is stored: a factory
            receiver's 115200. Boot listens at the stored rate first and scans
            the other rates only when nothing valid arrives. The receiver
            profile then moves COM1 to its own rate (460800 by default; above
            115200 the RX-full threshold is 64 B, see gnss_link_core.c).

    config GNSS_LINK_RX_BUF_SIZE
        int "UART driver RX buffer (bytes)"
        range 4096 65536
        default 32768
        help
            Software buffer behind the hardware FIFO (internal RAM). Must
            cover the longest time the RX task can be kept off the CPU at the
            highest baud rate in use: 32 KB is about 2.8 s at 115200 baud and
            0.7 s at 460800. PROVISIONAL, to be confirmed on hardware: the
            bench test (app update plus receiver package download while
            streaming) must end with zero buffer-full and FIFO-overflow
            events.

    config GNSS_LINK_RX_TASK_PRIO
        int "RX task priority"
        range 5 22
        default 18
        help
            Must stay above every caster and web task, so a network stall
            never starves the UART drain.

    config GNSS_LINK_RX_TASK_CORE
        int "RX task core (0/1)"
        range 0 1
        default 1
        help
            Wi-Fi runs on core 0; keeping the GNSS reader on core 1 isolates it
            from radio bursts. The UART interrupt is allocated on the same core.

    config GNSS_LINK_RX_TASK_STACK
        int "RX task stack (bytes)"
        range 3072 16384
        default 4096
        help
            Static stack in internal RAM. The sinks (hub publish, MSM
            inspection, reply matching) run on it. PROVISIONAL, to be
            confirmed on hardware from the task's stack high-water mark.

    config GNSS_LINK_BENCH_HOOKS
        bool "Bench hooks in the receiver link (bench builds only)"
        depends on BENCH_CONSOLE
        default y
        help
            Test hooks the bench console drives: an RX task stall (the
            reader sleeps without reading or feeding the task watchdog), a
            one-shot stall inside the next RAW-lease read, a recorder of
            frame and drain-pass times in a static PSRAM ring (read to
            published latency, drain behaviour after a stall, delay of each
            epoch against its MSM time), the loader prompt detector in
            report-only mode, and closing the UART driver so its reopen
            schedule installs it again. Nothing runs unless a bench command
            asks for it. The release job refuses a build with this on.

endmenu
```

## components/health/Kconfig
```kconfig
# SPDX-FileCopyrightText: 2026 Avery L.
# SPDX-License-Identifier: MIT
menu "Station: health monitor"

    config HEALTH_GNSS_STALL_S
        int "Seconds without RTCM before the GNSS path counts as stalled"
        range 3 600
        default 10
        help
            First rung of the recovery ladder. PROVISIONAL, to be confirmed
            on hardware.

    config HEALTH_SURVEY_HOLDS_RTCM
        bool "The receiver sends no RTCM while it surveys its position"
        default n
        help
            Set this if the receiver holds back all RTCM output during its
            survey-in. While the station's survey window is open the
            recovery ladder then declares no stall and lets no grace period
            run out; once the window ends, missing RTCM is a normal stall.
            Leave it off when observations keep flowing during the survey.
            PROVISIONAL, to be confirmed on hardware.

    config HEALTH_TASK_STACK
        int "Health monitor task stack (bytes)"
        range 4096 16384
        default 6144
        help
            Internal RAM: the task writes settings (BOOT-button actions) and
            journal records, and formats log lines. PROVISIONAL, to be tuned
            from the task's stack high-water mark.

    config HEALTH_HEAP_FRAGMENT_KB
        int "Alert when the largest free internal block drops below (KB)"
        range 4 128
        default 16

    config HEALTH_BUTTON_ADMIN_S
        int "BOOT button hold to clear the admin password (s)"
        range 3 30
        default 10
        help
            Clears the admin password and starts the recovery setup AP so
            the owner can set a new one. Physical presence is the
            authorisation.

    config HEALTH_BUTTON_FACTORY_S
        int "BOOT button hold for a factory reset (s)"
        range 10 60
        default 20

    config HEALTH_REBOOT_HOLD_ADMIN_S
        int "An admin's web request holds the GNSS ladder's restart for (s)"
        range 60 1800
        default 300
        help
            The ladder's ESP32 restart waits while an admin session made a
            request or sent a WebSocket ping within this window (the open
            web page pings every few seconds). PROVISIONAL, to be confirmed
            on hardware.

    config HEALTH_REBOOT_HOLD_MAX_MIN
        int "Longest presence hold of the GNSS ladder's restart per episode (min)"
        range 5 240
        default 30
        help
            A client on the station's access point and an admin using the
            web page together hold the ladder's ESP32 restart back for at
            most this long per ladder episode; then it runs anyway. The same
            limit as the network ladder's for AP clients. PROVISIONAL, to be
            confirmed on hardware.

    config HEALTH_REBOOT_POWER_ON_GRACE_MIN
        int "No GNSS ladder restart this long after power-on without a receiver (min)"
        range 0 240
        default 60
        help
            Station time since power-on (across software resets) during
            which the ladder's ESP32 restart waits as long as nothing valid
            was heard from the receiver in this boot: a restart cannot clear
            an ESP32-side fault that the power-on itself just cleared, and
            it would cut the setup network on a first start without a
            receiver. A receiver that streamed in this boot and then stalled
            is not held. PROVISIONAL, to be confirmed on hardware.

    config HEALTH_NET_REBOOT_MIN_INTERVAL_H
        int "Minimum hours between network-ladder reboots"
        range 1 48
        default 6

endmenu
```

## components/ledger/Kconfig
```kconfig
# SPDX-FileCopyrightText: 2026 Avery L.
# SPDX-License-Identifier: MIT
menu "Station: availability ledger"

    config LEDGER_TARGET_PERMILLE
        int "Daily graced-uptime target (per mille)"
        range 900 1000
        default 998
        help
            Graced uptime the protected (Onocoy) slot needs per UTC day.
            Onocoy's streak needs Availability >= 0.98, which on its scoring
            curve means a graced uptime of 99.8 %: with the daily grant below
            that is about 473 s of downtime per UTC day at a perfect data
            rate (a plain 98 % uptime would score only about 0.81).

    config LEDGER_GRACE_S
        int "Daily downtime grant of the protected slot (s)"
        range 0 3600
        default 300
        help
            Seconds Onocoy adds to each day's uptime before scoring it.

    config LEDGER_HISTORY_DAYS
        int "Days of per-day history kept"
        range 7 90
        default 30

    config LEDGER_PLANNED_BOOT_S
        int "After a planned reboot, count a caster's reconnect as planned for at most (s)"
        range 0 600
        default 120
        help
            A reboot the user asked for (restart, app update or rollback,
            factory reset, leaving safe mode) is planned downtime: the gap
            until the next boot, and each caster's time after the boot until
            it streams again, at most this long after the boot. A normal
            boot streams again within about 20-40 s (boot, Wi-Fi association
            and DHCP, the receiver keeps streaming, one caster connect and
            perhaps one quick retry while the caster lets go of the old
            session); 120 s leaves room for a slow access point. A caster
            still down after that has a problem of its own (Wi-Fi, internet,
            the caster), which counts as unplanned like after any other
            boot. The downtime counts against the daily budget either way;
            this only decides how much of it is shown as planned. 0 = only
            the gap until the boot.

    config LEDGER_ALIVE_PERSIST_S
        int "Persist the last-alive mark every (s)"
        range 10 600
        default 60
        help
            After a power cut, the time between this mark and the next boot
            is counted as downtime. When today's counters changed since the
            last store (some slot was down, or the protected slot lost
            epochs, in the meantime) they are stored with the mark as one
            record, in one write; otherwise the mark alone is written.
            Shorter is more exact but writes NVS more often: at 60 s the
            mark alone is about 1500 page erases per page in 10 years with
            the 112 KB NVS partition, and the record stored at every mark
            for years (a slot that stays down, or lost epochs every
            interval) makes it about six times that (the record is six NVS
            entries, the mark alone one), still well inside the flash's
            rating.

endmenu
```

## components/lifecycle/Kconfig
```kconfig
# SPDX-FileCopyrightText: 2026 Avery L.
# SPDX-License-Identifier: MIT
menu "Station: lifecycle (boot guard, safe mode, reboots)"

    config LIFECYCLE_STABLE_UPTIME_S
        int "Seconds of uptime that count as a stable boot"
        range 30 3600
        default 120
        help
            Reaching this uptime in normal mode clears the crash counter.
            (App update confirmation has its own, stricter criteria in the
            firmware update settings.)

    config LIFECYCLE_BOOTLOOP_LIMIT
        int "Crashes before safe mode"
        range 2 20
        default 5
        help
            Panics, watchdog resets and failed boots since the last stable
            boot. Brownouts and power cuts never count: they raise a
            power-supply alert instead. Safe mode keeps Wi-Fi, the web UI,
            the update check and app installs running but leaves the
            receiver path and casters off.
            It retries a normal boot after 1 h, 4 h, then every 24 h.

    config LIFECYCLE_SHUTDOWN_BUDGET_MS
        int "Time allowed for shutdown hooks before a reboot (ms)"
        range 200 5000
        default 1500
        help
            Casters use this to close their sessions cleanly so the caster
            accepts the reconnect right after the reboot.

    config LIFECYCLE_FATAL_RETRY_S
        int "Delay before rebooting after a mandatory boot step failed (s)"
        range 1 300
        default 30

    config LIFECYCLE_MAX_INHIBITS
        int "Maximum simultaneous reboot inhibits"
        range 2 16
        default 6

endmenu
```

## components/local_caster/Kconfig
```kconfig
# SPDX-FileCopyrightText: 2026 Avery L.
# SPDX-License-Identifier: MIT
menu "Station: local NTRIP for a rover"

    config LOCAL_CASTER_PORT
        int "TCP port rovers connect to"
        range 1024 65535
        default 2101
        help
            TCP port rovers connect to (never 80 or 53: the range starts at
            1024). Every rover app accepts 2101; this is not a user setting,
            only an option for a special build.

    config LOCAL_CASTER_MAX_LAG_MS
        int "Hub lag limit per rover (ms)"
        range 500 10000
        default 2000
        help
            Hub lag limit per rover: a rover that reads more slowly loses
            whole old epochs, which are dropped in the hub. Nothing waits
            in a private queue.

    config LOCAL_CASTER_TASK_PRIO
        int "Task priority"
        range 1 7
        default 4
        help
            Below the web server (5) and the caster slots (8), so a rover
            can never take CPU from the main stream.

    config LOCAL_CASTER_TASK_STACK
        int "Task stack (bytes)"
        range 4096 16384
        default 6144
        help
            Bytes, in PSRAM (the task does no flash work).

endmenu
```
