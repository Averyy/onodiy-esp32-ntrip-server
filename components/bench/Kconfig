## components/bench/Kconfig
```kconfig
# SPDX-FileCopyrightText: 2026 Avery L.
# SPDX-License-Identifier: MIT
menu "Station: bench console (bench builds only)"

    config BENCH_CONSOLE
        bool "Bench console on the UART0 console (never in a release)"
        depends on ESP_CONSOLE_UART
        default n
        select UM98X_FLASH_BYTE_CAPTURE
        help
            A command line on the UART0 console (115200, alongside the log)
            that drives the receiver flasher's bench tests one at a time:
            listen only, the version query, the loader entry probe, the menu
            item 2 probe, the loader idle observation, the stop key from
            boot (armed for one boot), a full same-build flash, a deliberate
            abort, and the journal-state helper. Every command that writes
            to the receiver asks for a typed confirmation word, runs through
            the station's normal ownership of the receiver link (casters
            paused, refused in maintenance and while anything else runs),
            records every byte (also downloadable from the web UI's
            Logs > Console) and prints a PASS/FAIL line. Nothing runs at boot
            except the one-shot stop key, and only when armed. The release
            job refuses a build with this on.

            The command line reads the console UART through the driver the
            log tap installs at boot (it never installs a second one), and
            its replies go out through the log's console writer a whole
            line at a time, so a log line never lands inside one.

endmenu
```

## components/board/Kconfig
```kconfig
# SPDX-FileCopyrightText: 2026 Avery L.
# SPDX-License-Identifier: MIT
menu "Station: board and pins"

    config BOARD_GNSS_UART_NUM
        int "UART port connected to GNSS receiver COM1"
        range 1 2
        default 1
        help
            ESP32-S3 UART controller used for the GNSS link. UART0 is the
            console (CH343P USB bridge), so use UART1 or UART2.

    config BOARD_GNSS_RX_GPIO
        int "ESP32 RX GPIO (receiver COM1 TXD)"
        range 0 48
        default 1
        help
            GPIO the ESP32 receives GNSS data on. Wired to the receiver's COM1
            TXD on the UM982 + ESP32-S3 dev board.

    config BOARD_GNSS_TX_GPIO
        int "ESP32 TX GPIO (receiver COM1 RXD)"
        range 0 48
        default 2
        help
            GPIO the ESP32 sends commands on. Wired to the receiver's COM1 RXD
            on the UM982 + ESP32-S3 dev board.

    config BOARD_GNSS_PORT
        int "Receiver port the ESP32 is wired to (1 = COM1)"
        range 1 3
        default 1
        help
            The receiver port at the other end of the GNSS link: 1 for COM1
            (the UM982 + ESP32-S3 dev board), 2 or 3 for a board wired to
            COM2 or COM3. Receiver firmware updates need COM1.

            These pins and this port are the build's defaults: a wiring saved
            on the station (Settings, Danger zone) replaces them at the next
            start and is kept by updates and a factory reset.

    config BOARD_GNSS_RESET_GPIO
        int "GPIO driving the receiver reset line (-1 = not wired)"
        range -1 48
        default -1
        help
            Optional hardware reset for the receiver. Not yet confirmed on the
            UM982 + ESP32-S3 dev board (check at bring-up whether the
            receiver's reset or power enable reaches any ESP32 GPIO). Without
            it, recovery uses receiver commands, and a receiver that stops
            answering raises a "needs a power cycle" alert.

    config BOARD_BUTTON_GPIO
        int "Recovery button GPIO (-1 = none)"
        range -1 48
        default 0
        help
            The BOOT button. GPIO0 is a strapping pin sampled only at reset,
            so it is an ordinary input afterwards. Held at runtime it clears
            the admin password or performs a factory reset (see the health
            monitor settings).

    config BOARD_STATUS_LED_GPIO
        int "Status LED GPIO (-1 = none)"
        range -1 48
        default -1

    config BOARD_SD_ENABLE
        bool "microSD slot present (reserved, not used yet)"
        default n

    if BOARD_SD_ENABLE
        config BOARD_SD_MISO_GPIO
            int "SD MISO GPIO"
            range 0 48
            default 4
        config BOARD_SD_MOSI_GPIO
            int "SD MOSI GPIO"
            range 0 48
            default 5
        config BOARD_SD_SCK_GPIO
            int "SD SCK GPIO"
            range 0 48
            default 6
        config BOARD_SD_CS_GPIO
            int "SD CS GPIO"
            range 0 48
            default 7
    endif

endmenu
```

## components/diag/Kconfig
```kconfig
# SPDX-FileCopyrightText: 2026 Avery L.
# SPDX-License-Identifier: MIT
menu "Station: diagnostics"

    config DIAG_LOG_RING_KB
        int "Log ring for the web UI (KB per boot, PSRAM, kept across resets)"
        range 8 1024
        default 64
        help
            Every log line is also copied here so it can be read remotely
            (web UI log view, WebSocket stream). The ring survives software,
            panic and watchdog resets, so the previous boot's last lines can
            be read after a crash: two rings of this size are kept in PSRAM,
            this boot's and the previous boot's.

    config DIAG_LOG_LINE_MAX
        int "Longest log line kept (bytes)"
        range 128 1024
        default 256
        help
            Each line is formatted on the stack of the task that logs, so
            this adds to every logging task's stack use. Longer lines are
            cut and end in "..." on the console and in the log ring.

    config DIAG_CONSOLE_TX_BUF
        int "Console transmit buffer (bytes, internal RAM)"
        range 1024 32768
        default 4096
        help
            The serial console runs at 115200 baud (about 11.5 KB/s). A log
            line goes straight into this buffer only when nothing older waits
            and the whole line fits, so a burst never stalls the task that
            logs. Otherwise the line waits in the log ring and the console
            task sends it as the buffer drains, in order. A line is lost only
            when the log ring overwrote it before it was sent; the console
            then says how many, on a line of its own.

    config DIAG_CONSOLE_TASK_STACK
        int "Console task stack (bytes, PSRAM)"
        range 2048 8192
        default 2560
        help
            The low-priority task that copies waiting log lines from the log
            ring to the console. It formats one short note and calls the
            UART driver; it never logs itself. Its stack is in PSRAM: the
            task only copies lines into the UART driver's transmit buffer
            and does no flash or NVS work (a PSRAM stack must never be in
            use while the cache is off). Only when PSRAM cannot provide the
            stack is it taken from internal RAM, and the boot log says so.

    config DIAG_CONSOLE_USB_MIRROR
        bool "Copy the console to the built-in USB (USB Serial/JTAG)"
        default n
        depends on SOC_USB_SERIAL_JTAG_SUPPORTED && ESP_CONSOLE_UART
        select USJ_ENABLE_USB_SERIAL_JTAG
        select ESP_PHY_ENABLE_USB if SOC_WIFI_PHY_NEEDS_USB_WORKAROUND
        help
            The station board's ESP32S3 USB-C port reaches the UART0
            console's USB bridge (CH343P) with the plug one way round and the
            chip's built-in USB Serial/JTAG the other way round. With this
            option the console's output (log lines, the bench console's
            replies) also goes out on the built-in USB, so either way round
            shows the log, and the built-in USB stays on while the station
            runs, so esptool can reset the chip into download mode through
            it. Console input stays on UART0 only.

            The copy never holds up the console: each write goes to the USB
            port's transmit buffer whole or not at all, without waiting.
            Without a host on that port nothing is sent; with one that does
            not read, what does not fit is dropped and counted (GET
            /api/health, log.usb_dropped), and the next line sent there says
            how many. The copy starts with diag, the first thing the app
            does: the app's startup lines before it and panic output are not
            copied.

            Off by default; bench builds turn it on (sdkconfig.bench). It
            keeps the USB PHY powered while Wi-Fi runs, with or without a
            host on the port (it selects ESP_PHY_ENABLE_USB and
            USJ_ENABLE_USB_SERIAL_JTAG), and the ESP-IDF help says that can
            lower Wi-Fi performance. How much on the station board has not
            been measured: compare the signal strength and throughput of one
            board with and without it before turning it on for a station.

            Turning it off in a build directory that had it on leaves the
            other two on there: that sdkconfig still says
            CONFIG_ESP_PHY_ENABLE_USB=y and
            CONFIG_USJ_ENABLE_USB_SERIAL_JTAG=y. Set all three to n in it
            (menuconfig, or edit the file):
                CONFIG_DIAG_CONSOLE_USB_MIRROR=n
                CONFIG_USJ_ENABLE_USB_SERIAL_JTAG=n
                CONFIG_ESP_PHY_ENABLE_USB=n
            or start a new build directory, which takes them from
            sdkconfig.defaults. The configure step warns when the USB PHY is
            on outside a bench build, or without this option.

    config DIAG_CONSOLE_USB_TX_BUF
        int "Built-in USB transmit buffer (bytes, internal RAM)"
        depends on DIAG_CONSOLE_USB_MIRROR
        range 512 16384
        default 4096
        help
            Room for what the console copies to the built-in USB while the
            host has not read it yet. The copy gets what the UART gets, as
            the UART's transmit buffer takes it, so the same size as that
            buffer (DIAG_CONSOLE_TX_BUF) holds a full burst while the host
            reads at USB speed.

    config DIAG_JOURNAL_MIN_INTERVAL_MS
        int "Minimum interval between journal records of one kind (ms)"
        range 0 60000
        default 1000
        help
            Rate limit that keeps a flapping condition from wearing out the
            journal partition. A record it refuses is reported as not
            written, so callers that accumulate deltas keep them pending.
            Health-ladder step records are exempt: one step's result and the
            next step's start fall in the same second, and the ladder bounds
            their rate itself (each step has a grace of at least 5 s).

    config DIAG_JOURNAL_BUDGET_PER_H
        int "Journal records per hour, all kinds together"
        range 60 36000
        default 1800
        help
            Second rate limit, over all kinds: at most this many records per
            hour on average, of which up to ten minutes' worth may come at
            once. Refused records are reported like the per-kind limit's;
            ladder step records are exempt. Every 127 records cost one
            sector erase: at the default, a journal written at the full rate
            without a break would take more than 20 years to reach 100 000
            erases per sector.

endmenu
```

## components/fw_update/Kconfig
```kconfig
# SPDX-FileCopyrightText: 2026 Avery L.
# SPDX-License-Identifier: MIT
menu "Station: firmware updates"

    config FW_UPDATE_GITHUB_REPO
        string "GitHub repository serving releases (owner/name)"
        default "Averyy/onocoydiy-esp-um982"
        help
            Releases of this repository carry the app image, the receiver
            package and a manifest. The repository must be public: devices
            send no access token. Without a manifest key (below) this is what
            a release is trusted for: it is fetched over HTTPS, certificate
            checked against the CA bundle, from GitHub's release hosts for
            this repository only, and every file must match the manifest's
            size and SHA-256. Forks point this at their own repository. Empty
            or not "owner/name": update checks are off. Only a build with a
            manifest key also takes a runtime override from settings
            (ota/repo).

    config FW_UPDATE_MANIFEST_ASSET
        string "Release manifest asset name"
        default "manifest.json"

    config FW_UPDATE_MANIFEST_KEY_1
        string "Manifest signing key 1 (public, hex; optional)"
        default ""
        help
            Optional. Leave empty (the default) and release manifests need no
            signature: the repository above, HTTPS and the per-file size and
            SHA-256 are the trust. Set it (e.g. a fork that signs its
            releases) and only manifests signed with key 1 or key 2 are used;
            an unsigned manifest is then refused, and so is everything when
            no configured key parses. The value is the public half of the
            signing key, the uncompressed P-256 point (04 || X || Y) as 130
            hex digits, e.g. from `openssl ec -pubin -in key.pub -text
            -noout` (colons and line breaks are ignored). The release
            workflow signs when the MANIFEST_SIGNING_KEY secret holds the
            private key (tools/release_manifest.py).

    config FW_UPDATE_MANIFEST_KEY_2
        string "Manifest signing key 2 (public, hex)"
        default ""
        help
            Second accepted key, so the signing key can be rotated: ship
            the next key here before signing releases with it. Setting
            either key makes signatures required.

    config FW_UPDATE_HTTP_TIMEOUT_MS
        int "HTTP network timeout (ms)"
        range 5000 60000
        default 15000
        help
            Per connect/read timeout of the update check and the downloads.

    config FW_UPDATE_CHECK_INTERVAL_H
        int "Hours between automatic update checks (not a runtime setting)"
        range 24 168
        default 24
        help
            The check only looks for new releases and shows a banner in the
            web UI; installing always needs the user's confirmation. The
            first check runs a few minutes after boot.

    config FW_UPDATE_HTTP_BUF_SIZE
        int "HTTP client receive/transmit buffer (bytes)"
        range 2048 16384
        default 4096
        help
            GitHub release downloads redirect to signed CDN URLs that are
            often longer than 1000 characters. The request line is built in
            the transmit buffer, so both buffers must hold such a URL.

    config FW_UPDATE_MAX_REDIRECTS
        int "Maximum HTTP redirects followed"
        range 1 10
        default 5

    config FW_UPDATE_MANIFEST_MAX_KB
        int "Largest manifest accepted (KB)"
        range 4 64
        default 8

    config FW_UPDATE_CONFIRM_S
        int "Stage 1: seconds before a new app image is confirmed"
        range 20 600
        default 60
        help
            Until then the bootloader rolls back on any reset, including a
            power blip, so the window is short. The real acceptance test is
            stage 2.

    config FW_UPDATE_VERIFY_WINDOW_S
        int "Stage 2: seconds a new image has to reach the saved baseline"
        range 120 3600
        default 600

    config FW_UPDATE_CRASH_WATCH_H
        int "Stage 2: hours of crash watch after an update"
        range 1 168
        default 24

    config FW_UPDATE_CRASH_REVERT_COUNT
        int "Crash resets during the watch that revert the update"
        range 1 20
        default 3

endmenu
```
