## components/station/Kconfig
```kconfig
# SPDX-FileCopyrightText: 2026 Avery L.
# SPDX-License-Identifier: MIT
menu "Station: receiver supervisor"

    config STATION_TASK_STACK
        int "Supervisor task stack (bytes)"
        range 4096 16384
        default 8192
        help
            Internal RAM (the task writes settings). Detection, the profile
            apply and the command layer's session executor run on it.
            PROVISIONAL, to be confirmed on hardware from the task's stack
            high-water mark.

    config STATION_FLASH_RESTART_ALLOWANCE_S
        int "Receiver write, restart and reacquisition allowance for an update (s)"
        range 30 900
        default 180
        help
            Added to the transfer time at the loader baud (package size,
            10 bits per byte, plus 10 %) to estimate a receiver update's
            downtime for the confirmation dialog. Information only: it never
            gates an update. Refine from measured runs.

    config STATION_LIVE_VIEW_MIN
        int "Live view: window length (minutes)"
        range 1 60
        default 10
        help
            How long the live view stays open after the user opens it; the
            user can extend it. While it is open the receiver's
            satellite-in-view output is on (never saved), so it is kept
            short and closes by itself.

    config STATION_LIVE_VIEW_MAX_MIN
        int "Live view: longest window, extensions included (minutes)"
        range 10 240
        default 60

    config STATION_LIVE_VIEW_IDLE_S
        int "Live view: close when no admin client asked for it this long (s)"
        range 30 900
        default 120
        help
            The web API reports every live-view request; a window nobody
            looks at closes after this long and the receiver output it
            turned on is turned off again.

    config STATION_LIVE_VIEW_SKY_PERIOD_S
        int "Live view: satellite-in-view output period (s)"
        range 1 60
        default 5
        help
            Period of the receiver's satellite-in-view sentences while the
            live view is open (azimuth and elevation for the sky plot). A
            modest period keeps the extra load on the receiver link small
            next to the RTCM stream. PROVISIONAL, to be confirmed on
            hardware.

endmenu
```

## components/um98x_flash/Kconfig
```kconfig
# SPDX-FileCopyrightText: 2026 Avery L.
# SPDX-License-Identifier: MIT
menu "Station: receiver flasher"

    config UM98X_FLASH_ENABLE
        bool "Receiver firmware updates (send packages to the receiver)"
        default y
        help
            Builds the receiver flasher in: a receiver package the user
            confirmed (a release from the update banner, or an uploaded
            file) is sent to the receiver's loader, and an interrupted
            update is finished at boot. Off: packages can still be uploaded
            and checked against every pre-flight rule, the web UI says that
            receiver firmware updates are not enabled in this build, and
            nothing is ever sent to the receiver's loader. On in releases
            since v0.1.6, after updates on a UM980 (the NTRIP-X: 11833
            again, then 11833 to 23980). The UM982 uses the same loader
            steps; no UM982 update has run on hardware yet.

    config UM98X_FLASH_RECOVERY_ACTIONS
        bool "Send the boot-time recovery actions for an interrupted receiver update"
        depends on UM98X_FLASH_ENABLE
        default n
        help
            With an open receiver-flash journal, the boot picks the first
            bytes, baud rates and timeouts from the journal state and the
            reset reason (for example racing into the receiver's loader
            after a power cut). Off: it logs what it would send and sends
            nothing; the session then waits for the user. PROVISIONAL, to be
            confirmed on hardware.
            Not ready to turn on: the table takes a power-on reset for a
            receiver restart, but on the ESP32-S3 a reset by the EN pin
            (the USB serial chip's auto-reset, the RST button) reads as
            power-on while the receiver keeps running, still in its loader
            or in a transfer. The recovery must check the receiver first
            (station.c, station_early_boot).

    config UM98X_FLASH_FALLBACK_115200
        bool "Allow the 115200 baud fallback for loader entry and transfer"
        depends on UM98X_FLASH_ENABLE
        default n
        help
            Loader entry and transfer run at 460800. When enabled, an entry
            attempt that follows a failed attempt which never reached the
            loader prompt may run at 115200 instead. It is one of the
            session's three entry attempts, under the same journal: it never
            starts a second session on its own, and once the attempts are
            used up a new try needs the user's confirmation. Off until it is
            proven on hardware. PROVISIONAL, to be confirmed on hardware.

    config UM98X_FLASH_CROSS_LAYOUT
        bool "Allow packages with another partition layout (with their own confirmation)"
        depends on UM98X_FLASH_ENABLE
        default y
        help
            A package whose partition table differs from the one of the
            receiver's current build moves receiver flash regions. Refused
            while off; when on, such a package still needs its own explicit
            confirmation. Tested on hardware: a UM980 from build 11833 to
            23980 (the NTRIP-X, 2026-10-22). A UM982 layout change is not
            tested yet.

    config UM98X_FLASH_BYTE_CAPTURE
        bool "Capture every receiver byte (bench builds)"
        default n
        help
            Every byte sent to and received from the receiver by the
            flasher and the bench console, time-stamped as hex and text, in
            a 256 KB PSRAM ring (downloadable from the web UI's Logs > Console)
            and on the console. Selected by the bench console; never in a
            release.

endmenu
```

## components/web/Kconfig
```kconfig
# SPDX-FileCopyrightText: 2026 Avery L.
# SPDX-License-Identifier: MIT
menu "Station: web server"

    config WEB_PBKDF2_ITERATIONS
        int "Admin password hash cost (PBKDF2-HMAC-SHA256 iterations)"
        range 1000 1000000
        default 10000
        help
            Iterations for a newly set admin password. One check should take
            about 0.3 s on the device; the count is stored with each hash,
            so changing it needs no migration (existing passwords keep their
            count until they are changed). PROVISIONAL, to be measured on
            hardware.

    config WEB_REQUEST_DEADLINE_S
        int "Time a client gets to send one request (s)"
        range 5 30
        default 6
        help
            One server task reads every request. From the first byte of a
            request (request line and headers, a JSON body, a WebSocket
            frame) the whole of it must arrive within this time, or the
            connection is closed (408 while headers are read). Without this
            limit a client sending a byte every few seconds could hold the
            server, and every status push queued behind it, for hours. A
            browser sends a request at once, so even a slow phone on the
            setup access point needs a fraction of a second; 6 s also covers
            two lost and resent TCP segments. Uploads are read by the worker
            task at the client's pace and are not bounded by it. Must be
            longer than the 4 s a single receive may wait.

endmenu
```

## components/web_shell/Kconfig
```kconfig
# SPDX-FileCopyrightText: 2026 Avery L.
# SPDX-License-Identifier: MIT
menu "Station: web server"

    config WEB_PBKDF2_ITERATIONS
        int "Admin password hash cost (PBKDF2-HMAC-SHA256 iterations)"
        range 1000 1000000
        default 3000
        help
            Iterations for a newly set admin password. Measured on the
            ESP32-S3: about 1.0 s per 10 000 iterations, so 3000 take about
            0.3 s (PROVISIONAL until measured again on the station). The
            check runs on the web server's task, which answers nothing else
            meanwhile; the login throttle bounds how often one client can
            make it run. The count is stored with each hash: existing
            passwords keep theirs (10 000 for those set by earlier builds)
            until they are changed, and a login never re-hashes a password
            silently.

    config WEB_REQUEST_DEADLINE_S
        int "Time a client gets to send one request (s)"
        range 5 30
        default 6
        help
            One server task reads every request. From the first byte of a
            request (request line and headers, a JSON body, a WebSocket
            frame) the whole of it must arrive within this time, or the
            connection is closed (408 while headers are read). Without this
            limit a client sending a byte every few seconds could hold the
            server, and every status push queued behind it, for hours. A
            browser sends a request at once, so even a slow phone on the
            setup access point needs a fraction of a second; 6 s also covers
            two lost and resent TCP segments. Uploads are read by the worker
            task at the client's pace and are not bounded by it. Must be
            longer than the 4 s a single receive may wait.

endmenu
```

## examples/external-web/sdkconfig.defaults
```kconfig
# SPDX-FileCopyrightText: 2026 Avery L.
# SPDX-License-Identifier: MIT
CONFIG_IDF_TARGET="esp32s3"
CONFIG_FREERTOS_HZ=1000
CONFIG_FREERTOS_TASK_NOTIFICATION_ARRAY_ENTRIES=2
CONFIG_SPIRAM=y
CONFIG_SPIRAM_MODE_OCT=y
CONFIG_SPIRAM_SPEED_80M=y
CONFIG_SPIRAM_USE_MALLOC=y
CONFIG_SPIRAM_ALLOW_BSS_SEG_EXTERNAL_MEMORY=y
CONFIG_SPIRAM_ALLOW_NOINIT_SEG_EXTERNAL_MEMORY=y
CONFIG_FREERTOS_USE_TRACE_FACILITY=y
CONFIG_FREERTOS_GENERATE_RUN_TIME_STATS=y
CONFIG_FREERTOS_RUN_TIME_COUNTER_TYPE_U64=y
CONFIG_FREERTOS_VTASKLIST_INCLUDE_COREID=y
CONFIG_HTTPD_WS_SUPPORT=y
CONFIG_HTTPD_WS_PRE_HANDSHAKE_CB_SUPPORT=y
CONFIG_HTTPD_WS_POST_HANDSHAKE_CB_SUPPORT=y
CONFIG_LWIP_SO_RCVBUF=y
CONFIG_LWIP_MAX_SOCKETS=30
CONFIG_LWIP_LOCAL_HOSTNAME="counter"
```
