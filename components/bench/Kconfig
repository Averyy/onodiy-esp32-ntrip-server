## components/network/Kconfig
```kconfig
# SPDX-FileCopyrightText: 2026 Avery L.
# SPDX-License-Identifier: MIT
menu "Station: network"

    config NETWORK_AP_SSID_PREFIX
        string "Setup AP SSID prefix"
        default "onocoydiy-"
        help
            The setup access point is named <prefix><last 4 hex digits of MAC>.

    config NETWORK_AP_CHANNEL
        int "Setup AP channel"
        range 1 13
        default 1

    config NETWORK_STA_FALLBACK_S
        int "Seconds without Wi-Fi before the setup AP also comes up"
        range 30 3600
        default 300
        help
            The station keeps retrying its configured network; after this long
            without a connection it additionally starts the setup AP (AP+STA)
            so the user can fix the credentials. The AP stops again
            NETWORK_AP_LINGER_S after the station has an IP (so the setup page
            can still show the new address).

    config NETWORK_AP_LINGER_S
        int "Seconds the setup AP stays up after the station got its IP"
        range 10 120
        default 15
        help
            An AP that is up for first setup or as the offline fallback stays
            up this long once the station has an IP on its network, so the
            setup page (on a phone still on the AP) can show the station's
            new address and count down to the moment the AP closes. Then the
            phone goes back to its own Wi-Fi and finds the station there.
            Not used for the recovery AP (BOOT button), which has its own
            lifetime.

    config NETWORK_RECOVERY_AP_S
        int "Recovery AP lifetime after a BOOT-button press (s)"
        range 120 3600
        default 900
        help
            The AP started by the BOOT button (admin password cleared, or
            settings unreadable) goes down again after this long, or later
            when the last connected client leaves, but at most 30 min after
            this lifetime even while a client stays connected.

    config NETWORK_WIFI_COUNTRY
        string "Wi-Fi country code"
        default "01"
        help
            ISO 3166 alpha-2 code, or "01" for the conservative worldwide
            setting. Sets the allowed channels and transmit power.

    config NETWORK_FALLBACK_DNS1
        string "Fallback DNS server 1"
        default "1.1.1.1"
        help
            Used by the network recovery ladder when the DHCP-provided DNS
            stops answering.

    config NETWORK_FALLBACK_DNS2
        string "Fallback DNS server 2"
        default "9.9.9.9"
        help
            Second server for the same switch. Both are also the targets of
            the upstream probe's TCP check (port 53) when a name lookup
            fails, which tells a DNS failure from no internet at all.

    config NETWORK_PROBE_HOST
        string "Upstream probe host"
        default "github.com"
        help
            Name looked up and connected to (TCP, closed at once, nothing
            sent) by the upstream probe, which tells "no IP" from "IP but no
            upstream" for the network recovery ladder. The default is a host
            the station talks to anyway (update check). Never a caster: a
            bare connect could count as a failed source login there.

    config NETWORK_PROBE_PORT
        int "Upstream probe TCP port"
        range 1 65535
        default 443

    config NETWORK_ROAM
        bool "Move between the access points of one network (mesh)"
        depends on !NETWORK_QEMU_ETHERNET
        default y
        help
            For a network of several access points under one name (a mesh,
            or a router with repeaters). The station tells its access point
            that it takes 802.11k radio measurement and 802.11v BSS
            transition requests, so the network can steer it to a better
            node, and while its own signal is weak it looks for a clearly
            stronger access point of the network and reconnects to it.
            Every move drops the caster sessions for a few seconds, so moves
            are rare: none during a firmware update or a receiver flash,
            none while the station's own access point is up or changed
            credentials are on trial, at most one the network asks for per
            5 min (unless it disconnects the station anyway) and one of the
            station's own per NETWORK_ROAM_MIN_INTERVAL_S. A strong signal
            never makes the station scan. Each move goes to the event
            journal. Off: the station joins the strongest access point when
            it connects and stays there until the link drops.
            The 802.11k/v support itself is ESP_WIFI_11KV_SUPPORT (on in
            sdkconfig.defaults).

    config NETWORK_ROAM_WEAK_DBM
        int "Weak signal for the station's own check (dBm)"
        depends on NETWORK_ROAM
        range -90 -50
        default -70
        help
            The station looks for a stronger access point only while its
            signal, averaged over about 20 s, has been at or below this for
            a minute.

    config NETWORK_ROAM_MIN_GAIN_DB
        int "How much stronger another access point must be (dB)"
        depends on NETWORK_ROAM
        range 6 30
        default 12
        help
            An access point of the same network at least this much stronger
            than the current one, in two scans 30 s apart, makes the station
            reconnect (the connect joins the strongest access point).

    config NETWORK_ROAM_MIN_INTERVAL_S
        int "Shortest time between two of the station's own moves (s)"
        depends on NETWORK_ROAM
        range 300 86400
        default 1800
        help
            Counted from the previous move of either kind, so a move the
            access point asked for also stands for at least this long.

    config NETWORK_QEMU_ETHERNET
        bool "QEMU development build: emulated Ethernet instead of Wi-Fi"
        depends on ETH_USE_OPENETH
        default y
        help
            For running the firmware in Espressif's QEMU only (the overlay
            sdkconfig.qemu at the repository root, tools/qemu/run.sh). It
            can only be turned on together with the OpenCores Ethernet MAC
            driver (ETH_USE_OPENETH), which exists in QEMU and on no real
            chip, and never with the defaults a station is built from.

            Wi-Fi is never initialised or started (QEMU has no radio). The
            emulated Ethernet port takes the station interface's place:
            same interface key and IP events, link up and down reported as
            the station's association, DHCP from QEMU's user-mode network.
            There is no setup AP. The web server accepts the Host names
            localhost and 127.0.0.1 (QEMU's port forward) and treats every
            request as if it came over the setup AP, so the first admin
            password can be set from the development machine.

            Configure refuses a release build with this option, and the
            release job refuses to publish one.

endmenu
```

## components/ntrip_server/Kconfig
```kconfig
# SPDX-FileCopyrightText: 2026 Avery L.
# SPDX-License-Identifier: MIT
menu "Station: NTRIP casters"

    config NTRIP_MAX_CASTERS
        int "Maximum caster slots"
        range 1 8
        default 4
        help
            Number of casters the station can stream to at once (Onocoy plus
            others). Each slot costs one task (created once at boot), one
            socket and, with TLS, tens of KB of PSRAM for the session.

    config NTRIP_TASK_PRIO
        int "Caster task priority"
        range 2 20
        default 8

    config NTRIP_TASK_STACK
        int "Caster task stack (bytes)"
        range 3072 16384
        default 8192

    config NTRIP_TCP_CONNECT_TIMEOUT_MS
        int "TCP connect timeout for plain slots (ms)"
        range 2000 30000
        default 5000

    config NTRIP_CONNECT_TIMEOUT_MS
        int "TLS slots: connect and handshake timeout (ms)"
        range 2000 60000
        default 10000
        help
            TLS slots: esp_tls timeout_ms. It bounds the connect and each
            handshake wait, so the handshake can take up to about twice
            this.

    config NTRIP_SEND_TIMEOUT_MS
        int "Write-stall limit (ms)"
        range 1000 60000
        default 10000
        help
            A caster that accepts no byte of pending data for this long
            (its TCP window stays full) is dropped and reconnected; the hub's
            lag limit keeps it from falling behind meanwhile.

    config NTRIP_CONNECT_BUDGET_S
        int "Longest a slot may stay CONNECTING (s)"
        range 20 300
        default 60
        help
            Covers DNS, connect, TLS and the caster's reply. The health
            monitor restarts a slot that overruns it (only that slot).

    config NTRIP_PROTECTED_MAX_BACKOFF_S
        int "Longest transient reconnect backoff for the protected (Onocoy) slot (s)"
        range 5 120
        default 30
        help
            Transient failures (network, timeouts, caster restarts) of the
            protected slot back off to 15 s, and to this cap after 10 min of
            continuous failure. Every second offline counts against the
            daily streak budget.

    config NTRIP_AUTH_TRANSIENT_WINDOW_S
        int "Treat rejections as transient for this long after a disconnect or boot (s)"
        range 60 1800
        default 300
        help
            Casters may still hold the previous session for a while after a
            reconnect and reply with an error that looks like a bad password.
            Within this window such a rejection, on credentials that worked
            before, follows the slot profile's "mountpoint busy" delays.

    config NTRIP_SOURCE_STALL_S
        int "Close a slot's session after this long without RTCM (s)"
        range 5 60
        default 10
        help
            Casters drop or count as bad a source that stays connected but
            silent (some after about 10-16 s). A pause for receiver work is
            a planned stall with the same limit.

    config NTRIP_PROTECTED_SOURCE_STALL_S
        int "Same for the protected (Onocoy) slot (s)"
        range 10 300
        default 60
        help
            Staying connected through a short stall costs the Onocoy streak
            less than reconnecting, if the caster keeps the silent session.
            PROVISIONAL, to be confirmed against the caster's idle timeout.

    config NTRIP_TEST_ONOCOY_SLOT
        bool "Allow test Onocoy slots (bench and QEMU builds only)"
        depends on BENCH_CONSOLE || NETWORK_QEMU_ETHERNET
        default y
        help
            A slot marked test_onocoy (PUT /api/casters/{n}) is treated
            exactly like an Onocoy slot whatever its host: protected, the
            fast retry profile, the Onocoy fields and wire names, the
            one-Onocoy rule and the Onocoy login guard. So a local test
            caster (on the bench, or the Mac at 10.0.2.2 from QEMU) sees the
            Onocoy retry behaviour without a DNS override. Never in a
            release: it depends on the bench console or the QEMU Ethernet
            option, and the release job refuses it.

endmenu
```

## components/pkg_store/Kconfig
```kconfig
# SPDX-FileCopyrightText: 2026 Avery L.
# SPDX-License-Identifier: MIT
menu "Station: receiver package staging"

    config PKG_STORE_RAM
        bool "Stage receiver packages in PSRAM on a board without the package partition"
        default y
        help
            A board whose partition table has no "gnss_pkg" partition (8 MB
            flash) keeps the package in one PSRAM buffer instead, from the
            download or upload to the end of the receiver update. It is not
            kept over a restart: an update cut short by one is finished
            with the same package downloaded (or uploaded) again. Off: no
            receiver updates on such a board.

    config PKG_STORE_RAM_MAX_KB
        int "Largest package staged in PSRAM (KB)"
        depends on PKG_STORE_RAM
        range 1024 6144
        default 3584
        help
            The largest receiver package is about 3 MB (UM980 build 25735:
            3,024,000 bytes; UM982 build 23575: 3,043,556 bytes).

    config PKG_STORE_RAM_MARGIN_KB
        int "PSRAM kept free beside a staged package (KB)"
        depends on PKG_STORE_RAM
        range 256 4096
        default 1024
        help
            A package is staged only when PSRAM has one free block of its
            size plus this much more: the flasher's decompression buffer
            (256 KB) and everything else the station allocates meanwhile.

endmenu
```

## components/rtcm_hub/Kconfig
```kconfig
# SPDX-FileCopyrightText: 2026 Avery L.
# SPDX-License-Identifier: MIT
menu "Station: RTCM fan-out hub"

    config RTCM_HUB_RING_KB
        int "Shared frame ring size (KB, PSRAM)"
        range 32 2048
        default 256
        help
            One ring holds every RTCM3 frame received from the GNSS link; all
            consumers (casters, live view, future local server/logger) read
            from it with their own cursor. 256 KB holds about two minutes of
            a full MSM7 set at 1 Hz.

    config RTCM_HUB_MAX_CONSUMERS
        int "Maximum simultaneous consumers"
        range 2 24
        default 12
        help
            Caster slots plus local consumers (web live view, local TCP server,
            SD logger).

    config RTCM_HUB_MAX_LAG_MS
        int "Default slow-consumer lag limit (ms)"
        range 500 60000
        default 3000
        help
            A consumer whose oldest unread frame is older than its limit
            drops whole oldest epochs (finishing one already partly sent)
            until it is back under the limit; the dropped frames count as
            data loss for that consumer. Corrections are only useful while
            fresh. This is the default; the Onocoy slot sets 1000 ms.

    config RTCM_HUB_BURST_GAP_MS
        int "Gap that starts a new epoch while an MSM epoch is open (ms)"
        range 100 500
        default 250
        help
            Fallback epoch rule for a lost terminating MSM: a frame arriving
            this long after the previous one starts a new epoch while the
            current epoch holds an MSM not yet marked as its last.

endmenu
```
